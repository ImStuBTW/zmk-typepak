## config/west.yml
```yaml
manifest:
  remotes:
    - name: zmkfirmware
      url-base: https://github.com/zmkfirmware
    - name: petejohanson
      url-base: https://github.com/petejohanson
    - name: kbrd-space
      url-base: https://github.com/kbrd-space
  projects:
    - name: zmk
      remote: zmkfirmware
      import: app/west.yml
      revision: v0.3
    - name: cirque-input-module
      remote: petejohanson
      revision: main
    - name: zmk-anti-idle
      remote: kbrd-space
      revision: main
  self:
    path: config
```
