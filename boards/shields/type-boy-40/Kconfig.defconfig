## boards/shields/type-boy-40/Kconfig.defconfig
```kconfig
if SHIELD_TYPEBOY

config ZMK_KEYBOARD_NAME
    default "Type Boy 40"

config SPI
    default y

config ZMK_POINTING
    default y

endif
```
